/******************************************************************************
 * @file a_temp.c
 * @author Seo Yujeong (yjseo@gst-in.com)
 * @brief 
 * @version 0.1
 * @date 2023-07-26
 * 
 * @copyright Copyright (c) 2023 Global Standard Technology Co., Ltd.
 * 
 * All rights reserved.
 * This file is part of closed source software.
 * Unauthorized reproduction and redistribution prohibited.
 *****************************************************************************/

/*****************************************************************************/
/** INCLUDES *****************************************************************/
/*****************************************************************************/

#include "UserApp.h"

/*****************************************************************************/
/** MACRO DEFINITIONS ********************************************************/
/*****************************************************************************/

#define NSEG 				( 255 )  // = number of sections in table

// K Type Thermocouple //
#define TMIN_K 				( -200.000000 )  // = minimum temperature in degC
#define TMAX_K 				( 1370.000000 )  // = maximum temperature in degC
#define TSEG_K 				( 6.156863 )  // = (TMAX-TMIN)/NSEG = temperature span in degC of each segment

// J Type Thermocouple //
#define TMIN_J 				( -210.000000 )  // = minimum temperature in degC
#define TMAX_J 				( 1200.000000 )  // = maximum temperature in degC
#define TSEG_J 				( 5.529412 )  // = (TMAX-TMIN)/NSEG = temperature span in degC of each segment

/* E Type Thermocouple */
#define TMIN_E 				( -200.000000 )  /* = minimum temperature in degC */
#define TMAX_E 				( 1000.000000 )  /* = maximum temperature in degC */
#define TSEG_E 				( 4.705882 )  /* = (TMAX-TMIN)/NSEG = temperature span in degC of each segment */

/* S Type Thermocouple */
#define TMIN_S 				( -50.000000 )  /* = minimum temperature in degC */
#define TMAX_S 				( 1768.000000 )  /* = maximum temperature in degC */
#define TSEG_S 				( 7.129412 )  /* = (TMAX-TMIN)/NSEG = temperature span in degC of each segment */

/* T Type Thermocouple */
#define TMIN_T 				( -200.000000 )  // = minimum temperature in degC
#define TMAX_T 				( 400.000000 )  // = maximum temperature in degC
#define TSEG_T 				( 2.352941 )  // = (TMAX-TMIN)/NSEG = temperature span in degC of each segment

// RTD //
#define RMIN 				( 18.5201 )  // = input resistance in ohms at -200 degC
#define RMAX 				( 390.481 )  // = input resistance in ohms at 850 degC
#define RSEG 				( 1.45867 )  // = (RMAX-RMIN)/NSEG = resistance RSEG in ohms of each segment

#define TC_VREF_VOLT		( 2.5 )
#define RTD_CIRCUIT_R_REF 	( 5110 )

/*****************************************************************************/
/** DATATYPES ****************************************************************/
/*****************************************************************************/
typedef struct Temp_Calib_struct
{
	Calib_Appl_st*			pAppl;
	Calib_AD7124_st			pAD7124;
} Temp_Calib_st;

typedef struct TEMP_struct
{
	float					ColdJ;
	float 					HotJ[ MAX_TEMP_CHANNEL ];
	uint32_t				SampleGeneration[ MAX_TEMP_CHANNEL ];
	Temp_Calib_st			Calib[ MAX_TEMP_CHANNEL ];
} TEMP_st;

/*****************************************************************************/
/** FUNCTION DECLARATIONS ****************************************************/
/*****************************************************************************/

static float Convert_mV_to_Temp( float mV, const float* lookup, const float minTemp, const float maxTemp, const float segment );
static float LUT_In_to_Out( float input, const float* lookup, const float minimum, const float maximum, const float segment );
static float TC_Conversion( sensor_et type, uint8_t ch, float ColdJTemp );
static float RTD_Conversion( sensor_et type, uint8_t ch );
static float calibrate_temp( uint8_t ch, float ConvertValue, const int MaxSection );
static float Calculate_Hot_Junction( int ch );
static void set_ch_type( int16_t ch, sensor_et type, uint16_t sampling_period );
static float get_ch_temp( int16_t ch );
static float get_cold_junction( void );
static float get_tc_mv( uint8_t ch );
static uint32_t get_sample_generation( uint8_t ch );
static float Convert_adc_to_mV( int32_t Value, float sampling_period );
static float Convert_adc_to_Resistor( sensor_et type, uint32_t Value, float sampling_period );

/*****************************************************************************/
/** LOCAL VARIABLES **********************************************************/
/*****************************************************************************/

static TEMP_st TEMP;

/************************ Lookup Table ****************************************
 * lookup table size:
 *   = 255 linear sections
 *   = 256 coefficients
 *   = 1024 bytes (4 bytes per floating point coefficient)
 ******************************************************************************/
static const float LUT_TC_K_Temp_to_mV[] = {-5.891835,-5.794422,-5.690184,-5.579308,-5.461951,-5.338265,-5.208392,-5.072469,-4.930632,-4.783015,-4.629752,-4.470978,-4.306828,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54.609573,54.818600};
static const float LUT_TC_J_Temp_to_mV[] = {-8.095914,-7.986020,-7.867712,-7.741319,-7.607138,-7.465456,-7.316554,-7.160697,-6.998147,-6.829153,-6.653957,-6.472793,-6.285888,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69.236488,69.553200};
static const float LUT_TC_E_Temp_to_mV[] = { -8.824926, -8.703908, -8.577435, -8.445674, -8.308756, -8.166804, -8.019934, -7.868249, -7.711854, -7.550846, -7.385322, -7.215374, -7.041091,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 76.019135, 76.372833 };
static const float LUT_TC_S_Temp_to_mV[] = { -0.235659, -0.206648, -0.176011, -0.143813, -0.110115, -0.074975, -0.038449, -0.000590, 0.038549, 0.078920, 0.120475, 0.163167, 0.206953,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 18.618471, 18.692583 };
static const float LUT_TC_T_Temp_to_mV[] = { -5.603009, -5.565586, -5.527396, -5.488444, -5.448736, -5.408276, -5.367068, -5.325116, -5.282423, -5.238993, -5.194829, -5.149935, -5.104314,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 20.726593, 20.871964 };
static const float LUT_RTD_Resistor_to_Temp[] = {-200.001,-196.622,-193.234,-189.836,-186.429,-183.013,-179.588,-176.153,-172.711,-169.259,-165.799,-162.33,-158.854,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845.02,849.999};

/*****************************************************************************/
/** GLOBAL VARIABLES *********************************************************/
/*****************************************************************************/
const temp_st Temp = 
{
	.SetType = set_ch_type,
	.GetTemp = get_ch_temp,
	.ConvToRes = Convert_adc_to_Resistor,
	.ConvTomV = Convert_adc_to_mV,
	.GetCjTemp = get_cold_junction,
	.GetTCTemp = TC_Conversion,
	.GetTCmV = get_tc_mv,
	.GetSampleGeneration = get_sample_generation,
};

/*****************************************************************************/
/** FUNCTION DEFINITIONS *****************************************************/
/*****************************************************************************/
/******************************************************************************
 * @brief Set the type of channel
 * 
 * @param ch 
 * @param type 
 * @param sampling_period 
 *****************************************************************************/
static void set_ch_type( int16_t ch, sensor_et type, uint16_t sampling_period )
{
	if( INVALID_CH != ch )
	{
		if( type == AD7124.GetType( ch ) && sampling_period == AD7124.GetSamplePeriod( ch ) )
			return;

		switch( type )
		{
			default:
			case SEN_NONE:
				return;
			case SEN_RTD2X:
				TEMP.Calib[ ch ].pAppl = Calib.data[ ch ].RTD2X;
				TEMP.Calib[ ch ].pAD7124 = Calib.data[ ch ].AD7124[ SEN_RTD2X ];
				break;
			case SEN_RTD:
				TEMP.Calib[ ch ].pAppl = Calib.data[ ch ].RTD;
				TEMP.Calib[ ch ].pAD7124 = Calib.data[ ch ].AD7124[ SEN_RTD ];
				break;
			case SEN_TC_K:
			case SEN_TC_J:
			case SEN_TC_E:
			case SEN_TC_S:
			case SEN_TC_T:
			case SEN_TC_R:
				TEMP.Calib[ ch ].pAppl = Calib.data[ ch ].TC;
				TEMP.Calib[ ch ].pAD7124 = Calib.data[ ch ].AD7124[ SEN_TC_K ];
				break;
			case SEN_COMM:
				return;
		}

		AD7124.SetType( ch, type );
		AD7124.SetSamplePeriod( ch, sampling_period );
		AD7124.ApplyCalibData( ch, TEMP.Calib[ ch ].pAD7124.gain, TEMP.Calib[ ch ].pAD7124.offset );
	}
}

/******************************************************************************
 * @brief Get the temperature of channel
 * 
 * @param ch 
 * @return float 
 *****************************************************************************/
static float get_ch_temp( int16_t ch )
{
	float temp = MINIMUM_PV;

	if( INVALID_CH != ch )
	{
		temp = TEMP.HotJ[ ch ];
	}

	return temp;
}

/******************************************************************************
 * @brief Get the cold junction temperature
 * 
 * @return float 
 *****************************************************************************/
static float get_cold_junction( void )
{
	return TEMP.ColdJ;
}

/******************************************************************************
 * @brief Return the application-calibrated TC input voltage in mV.
 *****************************************************************************/
static float get_tc_mv( uint8_t ch )
{
	if( ch >= MAX_TEMP_CHANNEL ) return 0.0f;

	return calibrate_temp( ch,
		Convert_adc_to_mV( AD7124.GetValue( ch ), AD7124.GetSamplePeriod( ch ) ),
		CALIB_TC_SECTION );
}

/******************************************************************************
 * @brief Return the number of completed temperature updates for one channel.
 *****************************************************************************/
static uint32_t get_sample_generation( uint8_t ch )
{
	if( ch >= MAX_TEMP_CHANNEL ) return 0;

	return TEMP.SampleGeneration[ ch ];
}


/******************************************************************************
 * @brief 
 * 
 * @param mV 
 * @param lookup 
 * @param minTemp 
 * @param maxTemp 
 * @param segment 
 * @return float 
 *****************************************************************************/
static float Convert_mV_to_Temp( float mV, const float* lookup, const float minTemp, const float maxTemp, const float segment )
{
	// set up initial values
	int i = NSEG / 2;                   // starting value for 'i' index
	int Add = ( i + 1 ) / 2;                // Add value used in do loop

	// determine if input v is within range
	if ( mV < lookup[ 0 ] )             // if input is under-range..
	{
		i = 0;                        // ..then use lowest coefficients
	}
	else if ( mV >lookup[ NSEG ] )     // if input is over-range..
	{
		i = NSEG - 1;                   // ..then use highest coefficients
	}

	// if input within range, determine which coefficients to use
	else do
	{
		if( lookup[ i ] > mV )  		{ i -= Add; 	} // either decrease i by Add..
		if( lookup[ i + 1 ] < mV ) 		{ i += Add; 	} // ..or increase i by Add
		if( i < 0 )       				{ i = 0;    	} // make sure i is >=0..
		if( i > NSEG - 1 )  			{ i = NSEG - 1; }    // ..and <=NSEG-1
		Add = ( Add + 1 ) / 2;            // divide Add by two (rounded)
	}while( ( lookup[ i ] > mV ) || ( lookup[ i + 1 ] < mV ) );  // repeat 'til done

	return ( minTemp + ( ( maxTemp - minTemp ) / NSEG ) * i + ( mV - lookup[ i ] ) * segment / ( lookup[ i + 1 ] - lookup[ i ] ) );
}

/******************************************************************************
 * @brief LUT calculation
 * 
 * @param input 
 * @param lookup 
 * @param minimum 
 * @param maximum 
 * @param segment 
 * @return float 
 * 
 * @note to find Output from LUT using Intput
 *****************************************************************************/
static float LUT_In_to_Out( float input, const float* lookup, const float minimum, const float maximum, const float segment )
{
	uint16_t idx = ( input - minimum ) / segment;       	// determine which coefficients to use

	if( idx < 0 )               			// if input is under-range..
	{
		idx = 0;                 			// ..then use lowest coefficients
	}
	else if( idx > NSEG - 1 )     		// if input is over-range..
	{
		idx = NSEG - 1;            		// ..then use highest coefficients
	}

	return ( lookup[ idx ] + ( input - ( minimum + segment * idx ) ) * ( lookup[ idx + 1 ] - lookup[ idx ] ) / segment );
}

/******************************************************************************
 * @brief 
 * 
 * @param type 
 * @param Value 
 * @return float 
 * 
 * @note AD7124의 설정이 bipolar이므로 2^n-1로 계산함.
 * Code = 2^(N-1) * ( ( Ain * Gain/2.5) + 1 )
 * Ain = ( Code / 2^(N-1) - 1 ) / Gain * 2.5
 *****************************************************************************/
static float Convert_adc_to_mV( int32_t Value, float sampling_period )
{
	float effectNum = AD7124.GetEffectBit( sampling_period, AD7124_PGA_TC ) * 2; // effectNum = 1/ 2^(N-1)

	Value *= AD7124_BIPOLAR_STEP / effectNum;			// delete ineffective num

	return  (float) Value * effectNum / ( 1 << AD7124_PGA_TC ) * ( TC_VREF_VOLT * 1000.0F );
}

/******************************************************************************
 * @brief 
 * 
 * @param type 
 * @param Value 
 * @param sps 
 * @return float 
 * 
 * @note Rrtd 구하는 방법
	Vrtd := Iexc * Rrtd
	Vref := 2 * Iexc * Rref
	ADC := Vrtd / ( Vref / ADC_GAIN ) * (1 << (ADC_BITDEPTH)) 
	ADC := ( Iexc * Rrtd ) / ( ( 2 * Iexc * Rref ) / ADC_GAIN ) * (1 << (ADC_BITDEPTH)) 
	ADC := Rrtd / ( ( 2 * Rref ) / ADC_GAIN ) * (1 << (ADC_BITDEPTH))
	Rrtd := ( ADC * 2 * Rref  ) / (1 << (ADC_BITDEPTH)) / ADC_GAIN
	ADC_BITDEPTH = 24bit -1(differential) - 5.7(무효bit) = 17.3bit
 *****************************************************************************/
static float Convert_adc_to_Resistor( sensor_et type, uint32_t Value, float sampling_period )
{
	uint8_t PgaGain;
	float effectNum;

	if( type == SEN_RTD2X )
	{
		PgaGain = 1 << AD7124_PGA_2X_RTD;
		effectNum = AD7124.GetEffectBit( sampling_period, AD7124_PGA_2X_RTD );
	}
	else
	{
		PgaGain = 1 << AD7124_PGA_RTD;
		effectNum = AD7124.GetEffectBit( sampling_period, AD7124_PGA_RTD );
	}

	Value *= AD7124_UNIPOLAR_STEP / effectNum;			// delete ineffective num
	return Value * ( 2 * RTD_CIRCUIT_R_REF * effectNum / PgaGain );
}

/******************************************************************************
 * @brief 
 * 
 * @param type 
 * @param ch 
 * @param ConvertValue 
 * @param MaxSection 
 * @return float 
 *****************************************************************************/
static float calibrate_temp( uint8_t ch, float ConvertValue, const int MaxSection )
{
	uint8_t index = MaxSection - 1;
	int32_t rawValue = AD7124.GetValue( ch );

	for( uint8_t i = 0; i < MaxSection; i++ )
	{
		if( rawValue <= TEMP.Calib[ ch ].pAppl[ i ].boundary )
		{
			index = i;
			break;
		}
	}
	return ( ( ConvertValue - TEMP.Calib[ ch ].pAppl[ index ].offset ) * TEMP.Calib[ ch ].pAppl[ index ].gain );
}

/******************************************************************************
 * @brief 
 * 
 * @param type 
 * @param ch 
 * @param ColdJTemp 
 * @return float 
 *****************************************************************************/
static float TC_Conversion( sensor_et type, uint8_t ch, float ColdJTemp )
{
	float result = 0.0f;
	float CJ_mV = 0.0f;
	float HJ_mV = calibrate_temp( ch, Convert_adc_to_mV( AD7124.GetValue( ch ), AD7124.GetSamplePeriod( ch ) ), CALIB_TC_SECTION );

	switch( type )
	{
		default:
		case SEN_TC_K:
			CJ_mV = LUT_In_to_Out( ColdJTemp, LUT_TC_K_Temp_to_mV, TMIN_K, TMAX_K, TSEG_K );
			result = Convert_mV_to_Temp( HJ_mV + CJ_mV, LUT_TC_K_Temp_to_mV, TMIN_K, TMAX_K, TSEG_K );
			break;
		case SEN_TC_J:
			CJ_mV = LUT_In_to_Out( ColdJTemp, LUT_TC_J_Temp_to_mV, TMIN_J, TMAX_J, TSEG_J );
			result = Convert_mV_to_Temp( HJ_mV + CJ_mV, LUT_TC_J_Temp_to_mV, TMIN_J, TMAX_J, TSEG_J );
			break;
		case SEN_TC_E:
			CJ_mV = LUT_In_to_Out( ColdJTemp, LUT_TC_E_Temp_to_mV, TMIN_E, TMAX_E, TSEG_E );
			result = Convert_mV_to_Temp( HJ_mV + CJ_mV, LUT_TC_E_Temp_to_mV, TMIN_E, TMAX_E, TSEG_E );
			break;
		case SEN_TC_S:
			CJ_mV = LUT_In_to_Out( ColdJTemp, LUT_TC_S_Temp_to_mV, TMIN_S, TMAX_S, TSEG_S );
			result = Convert_mV_to_Temp( HJ_mV + CJ_mV, LUT_TC_S_Temp_to_mV, TMIN_S, TMAX_S, TSEG_S );
			break;
		case SEN_TC_T:
			CJ_mV = LUT_In_to_Out( ColdJTemp, LUT_TC_T_Temp_to_mV, TMIN_T, TMAX_T, TSEG_T );
			result = Convert_mV_to_Temp( HJ_mV + CJ_mV, LUT_TC_T_Temp_to_mV, TMIN_T, TMAX_T, TSEG_T );
			break;
		case SEN_TC_R:
			break;
	}
	
	return result;
}

/******************************************************************************
 * @brief 
 * 
 * @param type 
 * @param ch 
 * @return float 
 *****************************************************************************/
static float RTD_Conversion( sensor_et type, uint8_t ch )
{
	float calib_Reistor = 0.0f;
	float Resistor = Convert_adc_to_Resistor( type, AD7124.GetValue( ch ), AD7124.GetSamplePeriod( ch ) );
	
	if( type == SEN_RTD2X )
	{
		calib_Reistor = calibrate_temp( ch, Resistor, CALIB_RTD_2X_SECTION );
	}
	else
	{
		calib_Reistor = calibrate_temp( ch, Resistor, CALIB_RTD_SECTION );
	}

	return LUT_In_to_Out( calib_Reistor, LUT_RTD_Resistor_to_Temp, RMIN, RMAX, RSEG );
}

/******************************************************************************
 * @brief 
 * 
 * @param ch 
 * @return float 
 *****************************************************************************/
static float Calculate_Hot_Junction( int ch )
{
	sensor_et type = AD7124.GetType( ch );
	float result = 0;

	switch( type )
	{
		case SEN_TC_K:
		case SEN_TC_J:
		case SEN_TC_E:
		case SEN_TC_S:
		case SEN_TC_T:
		case SEN_TC_R:
			result = TC_Conversion( type, ch, TEMP.ColdJ );
			break;
		case SEN_RTD2X:
		case SEN_RTD:
			result = RTD_Conversion( type, ch );
			break;
		case SEN_COMM:
		default:
			result = 2999.9F;
			break;
	}
	return fround( result );
}

/******************************************************************************
 * @brief 
 * 
 *****************************************************************************/
void TempInit( void )
{
	for( int ch = 0; ch < MAX_TEMP_CHANNEL; ch++ )
	{
		Temp.SetType( ch, SEN_RTD2X, DEFAULT_SAMPLING_PERIOD_MS );
	}
}

/******************************************************************************
 * @brief 
 * 
 *****************************************************************************/
void TemperatureTask( void )
{
	if( AD7124.dev[ 0 ].Status.cycled && AD7124.dev[ 1 ].Status.cycled )
	{
		AD7124.dev[ 0 ].Status.cycled = 0;
		AD7124.dev[ 1 ].Status.cycled = 0;
	
		TEMP.ColdJ = TCN75A.GetTemperature();
	}

	if( AD7124.dev[ 0 ].Status.aquired && AD7124.dev[ 1 ].Status.aquired )
	{
		AD7124.dev[ 0 ].Status.aquired = 0;
		AD7124.dev[ 1 ].Status.aquired = 0;
		
		Calib.status.vaild_raw_value = 1;

		for( int ch = 0; ch < MAX_TEMP_CHANNEL; ch++ )
		{
			TEMP.HotJ[ ch ] = Calculate_Hot_Junction( ch );
		}

		/* Both ADC devices acquire the same internal channel in lockstep.  Only
		 * those two external channels received a fresh conversion this cycle. */
		for( int dev = 0; dev < MAX_ADC_DEV; dev++ )
		{
			uint8_t ch = ( uint8_t )( dev * MAX_ADC_CH + AD7124.dev[ dev ].Status.channel );
			if( ch < MAX_TEMP_CHANNEL )
			{
				TEMP.SampleGeneration[ ch ]++;
			}
		}
	}
}
